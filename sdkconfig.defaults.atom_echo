## sdkconfig.defaults.atom_echo
```kconfig
## For Atom Lite + Atomic Speaker + PDM Unit
CONFIG_ESPTOOLPY_FLASHMODE_QIO=y
CONFIG_ESPTOOLPY_FLASHSIZE_4MB=y

CONFIG_MEDIA_I2S_HALF_DUPLEX=y
CONFIG_MEDIA_I2S_RX_I2S_NUM=0
CONFIG_MEDIA_I2S_TX_I2S_NUM=0

CONFIG_MEDIA_I2S_RX_PDM=y
CONFIG_MEDIA_I2S_RX_MCLK_PIN=-1
CONFIG_MEDIA_I2S_RX_BCLK_PIN=-1
CONFIG_MEDIA_I2S_RX_LRCLK_PIN=33
CONFIG_MEDIA_I2S_RX_DATA_PIN=23
CONFIG_MEDIA_I2S_TX_MCLK_PIN=-1
CONFIG_MEDIA_I2S_TX_BCLK_PIN=19
CONFIG_MEDIA_I2S_TX_LRCLK_PIN=33
CONFIG_MEDIA_I2S_TX_DATA_PIN=22

CONFIG_LIBPEER_VIDEO_RB_DATA_MTUS=32
CONFIG_LIBPEER_AUDIO_RB_DATA_MTUS=32
CONFIG_LIBPEER_DATA_RB_DATA_MTUS=16

CONFIG_MEDIA_SAMPLE_RATE_16K=y
CONFIG_WEBRTC_OPEN_DATA_CHANNEL=n
```
